#include "janky_custom.dtsi"

&kscan0 {
		// need 5 rows
		// and 9 columns
		// https://nicekeyboards.com/docs/nice-nano/pinout-schematic
		// columns along the left
		col-gpios
		    = <&pro_micro 2 GPIO_ACTIVE_HIGH>
		    , <&pro_micro 3 GPIO_ACTIVE_HIGH>
		    , <&pro_micro 4 GPIO_ACTIVE_HIGH>
		    , <&pro_micro 5 GPIO_ACTIVE_HIGH>
		    , <&pro_micro 6 GPIO_ACTIVE_HIGH>
		    , <&pro_micro 7 GPIO_ACTIVE_HIGH>
		    , <&pro_micro 8 GPIO_ACTIVE_HIGH>
		    , <&pro_micro 9 GPIO_ACTIVE_HIGH>
		    , <&pro_micro 21 GPIO_ACTIVE_HIGH>
		    ;
};
