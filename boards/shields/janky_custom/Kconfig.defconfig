## boards/shields/janky_custom/Kconfig.defconfig
```kconfig
if SHIELD_JANKY_CUSTOM_LEFT

# Name must be less than 16 characters long!
config ZMK_KEYBOARD_NAME
    default "Jankmaster666"

config ZMK_SPLIT_ROLE_CENTRAL
    default y

endif

if SHIELD_JANKY_CUSTOM_LEFT || SHIELD_JANKY_CUSTOM_RIGHT

config ZMK_SPLIT
    default y

endif
```

## boards/shields/janky_custom/Kconfig.shield
```kconfig
# No whitespace after the comma or in your part name!
config SHIELD_JANKY_CUSTOM_LEFT
    def_bool $(shields_list_contains,janky_custom_left)

# No whitespace after the comma or in your part name!
config SHIELD_JANKY_CUSTOM_RIGHT
    def_bool $(shields_list_contains,janky_custom_right)
```
